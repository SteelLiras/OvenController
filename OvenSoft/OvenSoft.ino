#include <pins_arduino.h>
#include <Arduino.h>
#include <avr/pgmspace.h>

const float lookupTemp[1024] PROGMEM = { -273.150, -16.227, -4.079, 3.583, 9.295, 13.895, 17.770, 21.133, 24.112, 26.793, 29.235, 31.480, 33.562,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 2333.720, 9999.99 };
const uint16_t lookupTime[1001] PROGMEM = { 0, 181, 256, 314, 363, 405, 444, 480, 513, 544, 574, 602, 629,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 8819, 9000 };

bool enforceSlope = false;
volatile bool justCrossedZero = false;
volatile unsigned long zeroCrossingTime = 0;
unsigned long heatingStartTime = 0;

#define ELAPSED (millis() - heatingStartTime)	//TODO: Maybe make it nicer?
#define CROSSING (millis() - zeroCrossingTime)

bool started = false;

#define BUFFERSIZE 7

struct Thermistor {
	unsigned char pin;
	int buffer[BUFFERSIZE];
	float temp = 0;
	float average = 0;
	void calculate() {
		volatile unsigned long sum = 0;
		for (int i = 0; i < BUFFERSIZE; i++) {
			sum += buffer[i];
		}
		average = ((float) sum) / ((float) BUFFERSIZE);
		temp = pgm_read_float_near(lookupTemp + ((int )(average + 0.5)));
	}
	void forceInit() {
		for (int i = 0; i < BUFFERSIZE; i++) {
			buffer[i] = analogRead(pin);
		}
		calculate();
		for (int i = 0; i < BUFFERSIZE; i++) {
			buffer[i] = average;
		}
	}
	int rejected = 0;
	void update() {
		int tempVal = analogRead(pin);
		if (abs(tempVal - buffer[BUFFERSIZE - 1]) < 10) {
			rejected = 0;
			for (int i = 0; i < BUFFERSIZE - 1; i++) {
				buffer[i] = buffer[i + 1];
			}
			buffer[BUFFERSIZE - 1] = tempVal;
		} else {
			rejected++;
		}
		if (rejected > 10) {
			forceInit();
		}
		calculate();
	}
};

#define THERMISTOR_CHANNEL_NR 2
Thermistor thermistors[THERMISTOR_CHANNEL_NR];

#define POINTS 20

struct event {
	uint32_t timeVal;
	float targetTemp;
};

struct ACchannel {
	int pin;
	int thermistorNo;
	bool channelEnabled = false;

	float target = 0;
	bool notStarted = false;
	unsigned int onTime = 0;

	event eventArray[POINTS];
	int totalEvents = 0;
	int currentEvent = -1;

	unsigned long endNodeTime = 0;
	int endNodeTemp = 0;
	unsigned long lastNodeEnd = 0;
	int lastNodeTemp = 0;

	void init() {
		endNodeTemp = thermistors[thermistorNo].temp;
		endNodeTime = ELAPSED;
		currentEvent = -1;
		nextNode();
		channelEnabled = true;
	}
	void eval() {
		if (notStarted && (CROSSING >= onTime) && (onTime < 9600) && channelEnabled) {
			digitalWrite(pin, HIGH);
			delayMicroseconds(7);   //experimental, do not "fix".
			digitalWrite(pin, LOW);
			notStarted = false;
		}
	}

	void nextNode() {
		currentEvent++;
		if (currentEvent == totalEvents) {
			channelEnabled = false;
			return;
		}
		lastNodeEnd = endNodeTime;   //TODO: A mode that waits until temperature is achieved before next node.
		lastNodeTemp = endNodeTemp;
		endNodeTemp = eventArray[currentEvent].targetTemp;
		endNodeTime = eventArray[currentEvent].timeVal;
	}

	float kP = 200.0;

	void calculatePID() {
		float temperature = thermistors[thermistorNo].temp;
		if (ELAPSED >= endNodeTime) {
			nextNode();
		}
		if (enforceSlope) {
			/*NEW:
			 if (endNodeTemp > lastNodeTemp) { //closer to current of the slope as-is or going from current temperature
			 target = min(
			 temperature
			 + ((float) (endNodeTemp - lastNodeTemp)) * 20.0
			 / ((float) (endNodeTime - lastNodeEnd)),
			 lastNodeTemp
			 + ((float) (endNodeTemp - lastNodeTemp))
			 * ((float) (ELAPSED - lastNodeEnd))
			 / ((float) (endNodeTime - lastNodeEnd)));
			 } else {
			 target = max(
			 temperature
			 + ((float) (endNodeTemp - lastNodeTemp)) * 20.0
			 / ((float) (endNodeTime - lastNodeEnd)),
			 lastNodeTemp
			 + ((float) (endNodeTemp - lastNodeTemp))
			 * ((float) (ELAPSED - lastNodeEnd))
			 / ((float) (endNodeTime - lastNodeEnd)));
			 }*/
			//OLD:
			target = lastNodeTemp + ((float) (endNodeTemp - lastNodeTemp)) * ((float) (ELAPSED - lastNodeEnd)) / ((float) (endNodeTime - lastNodeEnd));
		} else {
			target = endNodeTemp;
		}
		float difference = target - temperature;

		onTime = 9600 - pgm_read_word_near(lookupTime + ((int) (constrain(difference, 0, 999.5/kP) * kP)));
	}
};

#define AC_CHANNEL_NR 2
ACchannel channels[AC_CHANNEL_NR];

void zeroCrossing() {
	justCrossedZero = true;
	zeroCrossingTime = micros();
}

void setup() {

	pinMode(6, OUTPUT); //TRIAC
	pinMode(7, OUTPUT); //TRIAC
	pinMode(2, INPUT); //ZERO
	digitalWrite(6, LOW);
	digitalWrite(7, LOW);

	Serial.begin(115200);
	attachInterrupt(digitalPinToInterrupt(2), zeroCrossing, RISING);

	channels[0].pin = 6;
	channels[0].thermistorNo = 0;
	thermistors[0].pin = A0;
	channels[1].pin = 7;
	channels[1].thermistorNo = 1;
	thermistors[1].pin = A1;
}

int debugV = 0;

void updatePID() {
	for (int i = 0; i < THERMISTOR_CHANNEL_NR; i++) {
		thermistors[i].update();
	}
	for (int i = 0; i < AC_CHANNEL_NR; i++) {
		channels[i].calculatePID();
	}
}

void sendTemp() {
	Serial.print("T:");
	Serial.print(ELAPSED);
	Serial.print(":");
	Serial.print(thermistors[0].temp);
	Serial.print(":");
	Serial.print(thermistors[1].temp);
	Serial.print(":;");
}

int iter = 0;

void loop() {
	if (Serial.available() > 0) {
		char function = Serial.readStringUntil(';')[0];
		Serial.print("@;");
		switch (function) {
		case 'V': //get version
			Serial.print(POINTS);
			Serial.print(":0:"); //TODO: Finalize float support for temperature points.
			break;
		case 'C': //change enforce
			enforceSlope = (bool) Serial.readStringUntil(':').toInt();
			break;
		case 'S': //stop
			started = false;
			break;
		case 'Q':
			for (int i = 0; i < THERMISTOR_CHANNEL_NR; i++) {
				thermistors[i].forceInit();
			}
			int activeChannels = Serial.readStringUntil(':').toInt();
			for (int ch = 0; ch < activeChannels; ch++) {
				channels[ch].totalEvents = Serial.readStringUntil(':').toInt();
				for (int i = 0; i < channels[ch].totalEvents; i++) {
					channels[ch].eventArray[i].timeVal = Serial.readStringUntil(':').toInt(); //TODO: Better transfer method.
					channels[ch].eventArray[i].targetTemp = Serial.readStringUntil(':').toFloat();
				}
				channels[ch].init();
			}
			heatingStartTime = millis();
			started = true;
			break;
		}
		Serial.print(";");
	}
	if (started && justCrossedZero) {
		justCrossedZero = false;
		updatePID();
		if(iter == 0){
			sendTemp();
		}
		iter = (iter + 1) % 10; //TMP
		for (int i = 0; i < AC_CHANNEL_NR; i++) {
			channels[i].notStarted = true;
		}
	}

	for (int i = 0; i < AC_CHANNEL_NR; i++) {
		channels[i].eval();
	}
}
